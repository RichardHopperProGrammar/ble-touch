## ble-touch-bin/sdkconfig.defaults
```kconfig
CONFIG_ESP32C3_CHIP=y
CONFIG_BT_ENABLED=y
CONFIG_BT_NIMBLE_ENABLED=y
CONFIG_BT_NIMBLE_ROLE_PERIPHERAL=y
CONFIG_BT_NIMBLE_ROLE_CENTRAL=y
CONFIG_BT_NIMBLE_NVS_PERSIST=y
CONFIG_USB_OTG_FS_ENABLED=y
CONFIG_USB_OTG_MODE_DEVICE=y
CONFIG_CDC_ACM_CONSOLE=y
```
